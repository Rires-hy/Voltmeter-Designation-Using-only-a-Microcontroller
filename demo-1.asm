list p=pic18f458,F=INHX32,N=0,ST=OFF,R=HEX
#include <P18F458.INC>

CONFIG OSC=HS ;, OSCS=OFF;high-speed XTAL as clk source
CONFIG WDT=OFF;disable watchdog timer;

;Brown-out Reset Volt = 4.5V and Power-up Timer is on
;CONFIG BORV=45, PWRT=ON, BOR=ON

;no Background debug, no Reset if stack overflows, pin RB5=I/O
;CONFIG DEBUG=OFF, LVP=OFF, STVR=OFF

RESULT_H	EQU 50H
RESULT_L	EQU 51H
DENOM		EQU	52H
DECODE1		EQU 53H
INTEGER		EQU 54H
DECIMAL		EQU 55H
ZERO 		EQU 56H
ONE 		EQU 57H
TWO			EQU 58H
THREE       EQU 59H
FOUR		EQU 61H
FIVE		EQU 62H
SIX			EQU 63H
SEVEN		EQU 64H
EIGHT		EQU 65H
NINE		EQU 66H
R1 			EQU 0X67
R2 			EQU 0X68
R3 			EQU 0X69

		ORG 0000H
		GOTO MAIN

		ORG 0008H
		BTFSS PIR1,ADIF
		RETFIE
		GOTO AD_ISR
		
		ORG 100H
MAIN	BSF TRISA,0
		MOVLW 81H
		MOVWF ADCON0
		MOVLW 0CEH
		MOVWF ADCON1
		CLRF ADRESL
		CLRF ADRESH

		BCF PIR1,ADIF
		BSF PIE1,ADIE
		BSF INTCON,PEIE
		BSF INTCON,GIE

OVER 	BSF ADCON0,GO
		BRA OVER


AD_ISR	
		ORG 200H
		MOVFF ADRESL,RESULT_L
		MOVFF ADRESH,RESULT_H
		CALL QSEC_DELAY	
		CLRF DECODE1

		MOVLW D'0'
		CPFSEQ RESULT_H
		BRA HIGH_PROCESS
		BRA  LOW_PROCESS
HIGH_PROCESS
		INCF DECODE1,F	
		MOVLW D'24'
		MOVWF DENOM
		SUBWF RESULT_L,F
		MOVLW D'0'
		SUBWFB RESULT_H,F
		MOVLW D'0'
		CPFSEQ RESULT_H
		BRA  HIGH_PROCESS
LOW_PROCESS
		INCF DECODE1,F
		MOVLW D'24'
		SUBWF RESULT_L,F
		BC LOW_PROCESS
		DECF DECODE1,F
		
SEPARATED_PROCESS
		CLRF INTEGER
		CLRF DECIMAL
		MOVFF DECODE1,DECIMAL
		MOVLW D'10'
BACK 	INCF INTEGER,F
		SUBWF DECIMAL,F
		BC BACK
		DECF INTEGER,F
		ADDWF DECIMAL,F

DISPLAY 
		CLRF TRISB
		CLRF TRISC
		CLRF PORTB
		CLRF PORTC

		MOVLW D'0'
		MOVWF ZERO
		MOVLW D'1'
		MOVWF ONE
		MOVLW D'2'
		MOVWF TWO
		MOVLW D'3'
		MOVWF THREE
		MOVLW D'4'
		MOVWF FOUR
		MOVLW D'5'
		MOVWF FIVE
		MOVLW D'6'
		MOVWF SIX
		MOVLW D'7'
		MOVWF SEVEN
		MOVLW D'8'
		MOVWF EIGHT
		MOVLW D'9'
		MOVWF NINE

INTEGER_START		
		MOVF INTEGER,W
IF0		CPFSEQ ZERO
		BRA IF1
		MOVLW B'01000000' 
		MOVWF PORTB
IF1		CPFSEQ ONE
		BRA IF2
		MOVLW 0xF9 
		MOVWF PORTB
IF2		CPFSEQ TWO
		BRA IF3
		MOVLW 0xA4 
		MOVWF PORTB
IF3		CPFSEQ THREE
		BRA IF4
		MOVLW D'176' 
		MOVWF PORTB
IF4		CPFSEQ FOUR
		BRA IF5
		MOVLW 99H 
		MOVWF PORTB
IF5		CPFSEQ FIVE
		BRA IF6
		MOVLW 92H 
		MOVWF PORTB
IF6		CPFSEQ SIX
		BRA IF7
		MOVLW 82H 
		MOVWF PORTB
IF7		CPFSEQ SEVEN
		BRA IF8
		MOVLW 0xF8 
		MOVWF PORTB
IF8		CPFSEQ EIGHT
		BRA IF9
		MOVLW 80H 
		MOVWF PORTB
IF9		CPFSEQ NINE
		BRA DECIMAL_START
		MOVLW 90H 
		MOVWF PORTB

DECIMAL_START
		MOVF DECIMAL,W
IIF0	CPFSEQ ZERO
		BRA IIF1
		MOVLW B'01000000' 
		MOVWF PORTC
IIF1	CPFSEQ ONE
		BRA IIF2
		MOVLW 0xF9 
		MOVWF PORTC
IIF2	CPFSEQ TWO
		BRA IIF3
		MOVLW 0xA4 
		MOVWF PORTC
IIF3	CPFSEQ THREE
		BRA IIF4
		MOVLW D'176' 
		MOVWF PORTC
IIF4	CPFSEQ FOUR
		BRA IIF5
		MOVLW 99H 
		MOVWF PORTC
IIF5	CPFSEQ FIVE
		BRA IIF6
		MOVLW 92H 
		MOVWF PORTC
IIF6	CPFSEQ SIX
		BRA IIF7
		MOVLW 82H 
		MOVWF PORTC
IIF7	CPFSEQ SEVEN
		BRA IIF8
		MOVLW 0xF8 
		MOVWF PORTC
IIF8	CPFSEQ EIGHT
		BRA IIF9
		MOVLW 80H 
		MOVWF PORTC
IIF9	CPFSEQ NINE
		BRA HEERE
		MOVLW 90H 
		MOVWF PORTC
		
HEERE	BCF PORTB,7
		BCF PIR1,ADIE
		RETFIE
		
QSEC_DELAY
		MOVLW D'2'
		MOVWF R1
D1		MOVLW D'250'
		MOVWF R2
D2		MOVLW D'250'
		MOVWF R3
D3 		NOP
		NOP
		DECF R3,F
		BNZ D3
		DECF R2,F
		BNZ D2
		DECF R1,F
		BNZ D1	 
		RETURN

		END

